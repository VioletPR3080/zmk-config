## boards/shields/direct_test/Kconfig.defconfig
```kconfig
if SHIELD_DIRECT_TEST

config ZMK_KEYBOARD_NAME
	default "DirectTest"

config ZMK_KSCAN_DEBOUNCE_PRESS_MS
	default 1

config ZMK_KSCAN_DEBOUNCE_RELEASE_MS
	default 1

endif
```
